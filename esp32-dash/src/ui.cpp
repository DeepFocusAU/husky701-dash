#include "ui.h"
#include "config.h"
#include "SpeedDigits.h"   // generated by tools/mkfont.ps1
#include "ValueDigits.h"   // generated by tools/mkfont.ps1
#include "BigDigits.h"     // generated by tools/mkfont.ps1 (fuel range, trip distance)
#include "ClockDigits.h"   // generated by tools/mkfont.ps1 (clock page)

// ---- colours (RGB565) ----
static const uint16_t COL_BG       = TFT_BLACK;
static const uint16_t COL_PANEL    = TFT_BLACK; // panels blend into the black screen
static const uint16_t COL_EDGE     = 0x2124;   // faint panel outline
static const uint16_t COL_DIM      = 0x2104;   // unlit tacho segments / off chips
static const uint16_t COL_LABEL    = 0x9CF3;   // light grey
static const uint16_t COL_TEXT     = TFT_WHITE;
static const uint16_t COL_GREEN    = 0x07E0;
static const uint16_t COL_GREEN_DK = 0x03A0;   // tacho below the cruising band, lit
static const uint16_t COL_CRUISE_UNLIT = 0x0120; // cruising band, unlit (faint green)
static const uint16_t COL_AMBER    = 0xFDE0;   // RGB(255,191,0)
static const uint16_t COL_RED      = 0xF800;
static const uint16_t COL_BLUE     = 0x34DF;
static const uint16_t COL_ORANGE   = 0xFD20;   // Husqvarna-ish accent
static const uint16_t COL_CYAN     = 0x07FF;
static const uint16_t COL_YELLOW   = 0xFFE0;   // content on a red alarm fill

static const uint32_t ALARM_FLASH_MS = 250;    // half-period of the bad-state flash (2 Hz)

static const int W = 320;
static const int H = 170;

void DashUI::begin() {
    pinMode(PIN_LCD_POWER, OUTPUT);
    digitalWrite(PIN_LCD_POWER, HIGH);

    tft_.init();
    tft_.setRotation(3);                 // landscape, USB on the left
    tft_.fillScreen(COL_BG);

    // Full-screen sprite (320x170x16bit = 106 KB, goes in PSRAM) for
    // flicker-free redraws. Fall back to 8-bit colour if memory is short.
    spr_.setColorDepth(16);
    sprOk_ = spr_.createSprite(W, H) != nullptr;
    if (!sprOk_) {
        spr_.setColorDepth(8);
        sprOk_ = spr_.createSprite(W, H) != nullptr;
    }

    // Backlight PWM (Arduino-ESP32 core 2.x API)
    ledcSetup(0, 5000, 8);
    ledcAttachPin(PIN_LCD_BL, 0);
    ledcWrite(0, 255);
}

void DashUI::setBrightness(uint8_t level) {
    ledcWrite(0, level);
}

void DashUI::draw(const DashView &v, Page page) {
    if (!sprOk_) {
        tft_.setTextColor(COL_RED, COL_BG);
        tft_.drawString("Sprite alloc failed", 10, 10, 4);
        return;
    }
    spr_.fillSprite(COL_BG);
    if (page == Page::Main)      drawMain(v);
    else if (page == Page::Fuel) drawFuel(v);
    else if (page == Page::Trip)  drawTrip(v);
    else if (page == Page::Tyres) drawTyres(v);
    else if (page == Page::Gps)   drawGps(v);
    else if (page == Page::GpsData) drawGpsData(v);
    else if (page == Page::Clock) drawClock(v);
    else                         drawDiag(v);
    if (v.alertOn) drawAlert(v);
    spr_.pushSprite(0, 0);
}

// ---------------------------------------------------------------- main page
//
//  +------------------------------------------------------------+
//  | 6420              ▂▃▃▄▄▅▅▆▆▇▇██  big tacho bar (hero)        |
//  | 1   2   3   4   5   6   7   8   9   x1000 scale             |
//  +----------+-----------------+-------------------------------+
//  |          | COOLANT  92 °C  |                               |
//  |    3     |-----------------|          87   (road speed)    |
//  | big gear | BATTERY 14.2 V  |                               |
//  +----------+-----------------+-------------------------------+

static const int TACHO_H      = 50;    // bar area height (y 0..49)
static const int SCALE_Y      = 52;    // scale numbers
static const int CONTENT_Y    = 64;    // gear / values / speed panels
static const int CONTENT_H    = H - CONTENT_Y;
static const int PANEL_GAP    = 4;
static const int GEAR_W       = 88;
static const int MID_X        = GEAR_W + PANEL_GAP;
static const int MID_W        = 100;
static const int SPEED_X      = MID_X + MID_W + PANEL_GAP;
static const int SPEED_W      = W - SPEED_X;

void DashUI::drawMain(const DashView &v) {
    const bool live = v.linkAlive;
    const uint16_t rpm = live ? v.rpm : 0;
    const bool shift = live && rpm >= SHIFT_RPM;
    const bool lug   = live && v.lugging && !shift;
    const bool flashOn = (millis() / 80) % 2;   // ~6 Hz shift-light flash

    // ---- tacho (hero): red flash = shift up, blue flash = shift down ----
    updateTacho(rpm);
    drawTacho(!flashOn ? TachoAlert::None
              : shift  ? TachoAlert::ShiftUp
              : lug    ? TachoAlert::ShiftDown
              :          TachoAlert::None);

    // rpm digits sit top-left, above the short end of the bar
    char buf[16];
    snprintf(buf, sizeof(buf), live ? "%u" : "----", rpm);
    spr_.setTextDatum(TL_DATUM);
    spr_.setTextColor(COL_TEXT);
    spr_.setFreeFont(&FreeSansBold24pt7b);
    spr_.drawString(buf, 2, 0);
    spr_.setTextFont(1);                 // back to built-in fonts for the rest

    // ---- big gear: neutral green, any gear white ----
    spr_.drawRoundRect(0, CONTENT_Y, GEAR_W, CONTENT_H, 8, COL_EDGE);
    const int gcx = GEAR_W / 2, gcy = CONTENT_Y + CONTENT_H / 2;
    if (live) {
        drawGear(v.gear, gcx, gcy, (v.gear == 0) ? COL_GREEN : COL_TEXT);
        // shift chevrons, top-right of the gear panel, flashing with the tacho:
        // red double-up = shift up, blue double-down = shift down
        const int ax = GEAR_W - 16, ay = CONTENT_Y + 10;
        if (shift && flashOn) {
            spr_.fillTriangle(ax - 10, ay + 12, ax + 10, ay + 12, ax, ay, COL_RED);
            spr_.fillTriangle(ax - 10, ay + 20, ax + 10, ay + 20, ax, ay + 8, COL_RED);
        } else if (lug && flashOn) {
            spr_.fillTriangle(ax - 10, ay, ax + 10, ay, ax, ay + 12, COL_BLUE);
            spr_.fillTriangle(ax - 10, ay + 8, ax + 10, ay + 8, ax, ay + 20, COL_BLUE);
        }
    } else {
        spr_.setTextDatum(MC_DATUM);
        spr_.setTextColor(COL_RED);
        spr_.drawString("NO", gcx, gcy - 14, 4);
        spr_.drawString("LINK", gcx, gcy + 14, 4);
    }

    // ---- middle panel: coolant / battery alternate above the clock ----
    // If either is critical, both show (coolant top, battery bottom) and the
    // clock gives up its slot.
    const int rowH = (CONTENT_H - PANEL_GAP) / 2;
    const int row2Y = CONTENT_Y + rowH + PANEL_GAP;
    const bool coolCrit = live && v.coolantOk && v.coolantC >= COOLANT_WARN_C;
    const bool battCrit = v.vbatOk && (v.vbat > VBAT_HIGH_WARN ||
                                       (v.vbat < VBAT_LOW_WARN && v.rpm > 1000 && !v.vbatStarting));
    if (coolCrit || battCrit) {
        drawCoolant(MID_X, CONTENT_Y, MID_W, rowH, v);
        drawBattery(MID_X, row2Y, MID_W, rowH, v);
    } else {
        if ((millis() / VALUE_CYCLE_MS) % 2 == 0) drawCoolant(MID_X, CONTENT_Y, MID_W, rowH, v);
        else                                      drawBattery(MID_X, CONTENT_Y, MID_W, rowH, v);
        drawClock(MID_X, row2Y, MID_W, rowH, v);
    }

    // ---- road speed ----
    drawSpeed(SPEED_X, CONTENT_Y, SPEED_W, CONTENT_H, v);
}

// Icon, value and unit share one status colour: green good, amber warning,
// red bad (coolant also blue while cold); grey when there's no reading.
void DashUI::drawCoolant(int x, int y, int w, int h, const DashView &v) {
    char buf[8];
    uint16_t c = COL_LABEL;
    if (v.linkAlive && v.coolantOk) {
        if (v.coolantC >= COOLANT_WARN_C)      c = COL_RED;     // overheating
        else if (v.coolantC >= COOLANT_HOT_C)  c = COL_AMBER;   // running hot
        else if (v.coolantC < COOLANT_COLD_C)  c = COL_BLUE;    // still cold
        else                                   c = COL_GREEN;
        snprintf(buf, sizeof(buf), "%.0f", v.coolantC);
    } else {
        snprintf(buf, sizeof(buf), "--");
    }
    drawValue(x, y, w, h, Icon::Coolant, buf, true, c, c == COL_RED);
}

// Battery volts from the CAN node's ADC.
void DashUI::drawBattery(int x, int y, int w, int h, const DashView &v) {
    char buf[8];
    uint16_t c = COL_LABEL;
    if (v.vbatOk) {
        if (v.vbat > VBAT_HIGH_WARN)                       c = COL_RED;     // over-charging
        else if (v.vbatStarting)                           c = COL_GREEN;   // starter sag: ignore
        else if (v.vbat < VBAT_LOW_WARN && v.rpm > 1000)   c = COL_RED;     // not charging
        else if (v.vbat < VBAT_FLAT_WARN)                  c = COL_AMBER;   // getting flat
        else                                               c = COL_GREEN;
        snprintf(buf, sizeof(buf), "%.1f", v.vbat);
    } else {
        snprintf(buf, sizeof(buf), "--");
    }
    drawValue(x, y, w, h, Icon::Battery, buf, false, c, c == COL_RED);
}

// HH:MM in FreeSansBold18pt, each character in a fixed slot (digits 19 px,
// colon 9 px) so nothing shifts as the time changes. Ink spans baseline-24 ..
// baseline+1, so baseline = centre + 12 centres it.
void DashUI::drawClock(int x, int y, int w, int h, const DashView &v) {
    spr_.drawRoundRect(x, y, w, h, 6, COL_EDGE);
    char buf[6];
    if (v.clockOk) snprintf(buf, sizeof(buf), "%02u:%02u", v.hour, v.minute);
    else           snprintf(buf, sizeof(buf), "--:--");

    const int digitAdv = 19, colonAdv = 9;
    const int totalW = 4 * digitAdv + colonAdv;
    int cx = x + (w - totalW) / 2;
    const int baseY = y + h / 2 + 12;
    spr_.setFreeFont(&FreeSansBold18pt7b);
    spr_.setTextDatum(L_BASELINE);
    spr_.setTextColor(v.clockOk ? COL_TEXT : COL_LABEL);
    char one[2] = {0, 0};
    for (int i = 0; i < 5; i++) {
        one[0] = buf[i];
        const int adv = (i == 2) ? colonAdv : digitAdv;
        // FreeSans '-' is narrower than a digit: centre it in the digit slot
        const int dx = (buf[i] == '-') ? (adv - spr_.textWidth(one)) / 2 : 0;
        spr_.drawString(one, cx + dx, baseY);
        cx += adv;
    }
    spr_.setTextFont(1);
}

// Right-aligns s in one of the generated digit fonts, each char in its own
// glyph-advance slot so the number never shifts as digits change.
void DashUI::drawDigitsRight(const GFXfont &font, const char *s, int right, int baseY, uint16_t colour) {
    spr_.setFreeFont(&font);
    spr_.setTextDatum(L_BASELINE);
    spr_.setTextColor(colour);
    char one[2] = {0, 0};
    for (int i = strlen(s) - 1; i >= 0; i--) {
        const char ch = s[i];
        if (ch < font.first || ch > font.last) continue;
        right -= font.glyph[ch - font.first].xAdvance;
        one[0] = ch;
        spr_.drawString(one, right, baseY);
    }
    spr_.setTextFont(1);
}

// Road speed in SpeedDigits (bold sans like the gear and rpm): no built-in
// font sits between font 6 (48 px) and font 8 (75 px, too wide for 3 digits).
void DashUI::drawSpeed(int x, int y, int w, int h, const DashView &v) {
    spr_.drawRoundRect(x, y, w, h, 8, COL_EDGE);
    char buf[8];
    if (v.linkAlive) snprintf(buf, sizeof(buf), "%d", constrain((int)lroundf(v.speedKmh), 0, 999));
    else             snprintf(buf, sizeof(buf), "--");

    // Digit ink spans baseline-48 .. baseline+2, so baseline = centre + 22
    // puts the ink in the middle of the box. Right-aligned: each digit has
    // ~4 px of side bearing, so anchoring at the box edge leaves a 4 px margin
    // (and ~5 px on the left at three digits).
    //
    // Each digit is drawn in its own fixed 41 px slot. TFT_eSPI's R_ datums
    // measure the last character by its ink, not its advance, which made the
    // whole number shift whenever the last digit changed.
    const int adv = 41;                          // SpeedDigits tabular advance
    const int baseY = y + h / 2 + 22;
    const int n = strlen(buf);
    spr_.setFreeFont(&SpeedDigits);
    spr_.setTextDatum(L_BASELINE);
    spr_.setTextColor(COL_TEXT);
    char one[2] = {0, 0};
    for (int i = 0; i < n; i++) {
        one[0] = buf[i];
        spr_.drawString(one, x + w - 1 - (n - i) * adv, baseY);   // 1 px extra right margin
    }
    spr_.setTextFont(1);
}

// Smooth the bar towards the latest rpm (fast attack, softer release) and
// track the peak-hold marker.
void DashUI::updateTacho(uint16_t rpm) {
    const uint32_t now = millis();
    const float dtMs = lastDrawMs_ ? (float)(now - lastDrawMs_) : 0.0f;
    lastDrawMs_ = now;

    const float tau = (rpm > barRpm_) ? TACHO_RISE_MS : TACHO_FALL_MS;
    const float k = (dtMs <= 0) ? 1.0f : fminf(1.0f, dtMs / tau);
    barRpm_ += ((float)rpm - barRpm_) * k;

    if (TACHO_PEAK_HOLD_MS > 0) {
        if (rpm >= peakRpm_ || now - peakMs_ > TACHO_PEAK_HOLD_MS) {
            peakRpm_ = rpm;
            peakMs_ = now;
        }
    }
}

void DashUI::drawTacho(TachoAlert alert) {
    const bool flash = alert != TachoAlert::None;
    const bool down  = alert == TachoAlert::ShiftDown;
    const int segs = 36;
    const int gap = 2;
    const float segW = (float)(W - (segs - 1) * gap) / segs;
    const float litF = barRpm_ / RPM_MAX * segs;
    const int lit = (int)litF;
    const float partial = litF - lit;            // fractional top segment

    if (flash) spr_.fillRect(0, 0, W, TACHO_H, down ? 0x000C : 0x5000);   // blue / red wash behind the bar

    for (int i = 0; i < segs; i++) {
        const int sx = (int)(i * (segW + gap));
        const int sw = (int)segW;
        const float segRpm = (i + 1) * (float)RPM_MAX / segs;
        const bool cruise = segRpm > RPM_CRUISE_LOW && segRpm <= RPM_AMBER;
        uint16_t c = cruise ? COL_GREEN : COL_GREEN_DK;   // darker below the cruising band
        if (segRpm > RPM_AMBER) c = COL_AMBER;
        if (segRpm > SHIFT_RPM)  c = COL_RED;
        if (flash)               c = down ? COL_BLUE : TFT_WHITE;

        // segments grow taller towards the redline: classic tacho sweep.
        // Quadratic ramp keeps the left end low so the rpm digits fit above it.
        const float t = (float)i / (segs - 1);
        const int sh = 6 + (int)((TACHO_H - 6) * t * t);
        const int sy = TACHO_H - sh;

        if (i < lit) {
            spr_.fillRect(sx, sy, sw, sh, c);
        } else if (i == lit && partial > 0.05f) {
            // partly-lit segment fills from the bottom, so the bar moves smoothly
            const int ph = (int)(sh * partial);
            spr_.fillRect(sx, sy, sw, sh - ph, cruise ? COL_CRUISE_UNLIT : COL_DIM);
            spr_.fillRect(sx, sy + sh - ph, sw, ph, c);
        } else {
            spr_.fillRect(sx, sy, sw, sh, segRpm > SHIFT_RPM ? 0x2000
                                          : cruise ? COL_CRUISE_UNLIT : COL_DIM);
        }
    }

    // peak-hold marker
    if (TACHO_PEAK_HOLD_MS > 0 && peakRpm_ > 300) {
        const int px = (int)((float)peakRpm_ / RPM_MAX * W);
        spr_.fillRect(constrain(px - 2, 0, W - 3), 0, 3, TACHO_H, COL_BLUE);
    }

    // scale: 1..9 x1000 rpm, with the shift point marked
    spr_.setTextDatum(TC_DATUM);
    for (int k = 1; k * 1000 <= RPM_MAX; k++) {
        const int x = (int)((float)k * 1000 / RPM_MAX * W);
        char n[3];
        snprintf(n, sizeof(n), "%d", k);
        spr_.setTextColor(COL_TEXT);
        spr_.drawString(n, constrain(x - 4, 4, W - 6), SCALE_Y, 1);
    }
    const int sx = (int)((float)SHIFT_RPM / RPM_MAX * W);
    spr_.drawFastVLine(sx, SCALE_Y - 1, 10, COL_RED);
}

void DashUI::drawGear(uint8_t gear, int cx, int cy, uint16_t colour) {
    if (gear == 0) {
        drawBigN(cx, cy, colour);
        return;
    }
    // Font 8 digit ink spans rows 4..73 of the 75 px cell, about 1 px below
    // the cell centre, so lift by 1 to centre the ink itself.
    cy -= 1;
    spr_.setTextDatum(MC_DATUM);
    spr_.setTextColor(colour);
    if (gear == TELEM_GEAR_UNKNOWN) {
        spr_.drawString("-", cx, cy, 8);     // font 8: 75 px digits, '-', ':', '.'
    } else {
        char g[4];
        snprintf(g, sizeof(g), "%u", gear);
        spr_.drawString(g, cx, cy, 8);
    }
}

// Font 8 has digits only, so draw a matching neutral "N" from shapes.
void DashUI::drawBigN(int cx, int cy, uint16_t colour) {
    const int h = 70, w = 48, t = 12;   // same ink height as the font 8 digits
    const int x = cx - w / 2, y = cy - h / 2;
    spr_.fillRect(x, y, t, h, colour);                  // left stroke
    spr_.fillRect(x + w - t, y, t, h, colour);          // right stroke
    spr_.fillTriangle(x, y, x + t, y, x + w, y + h, colour);   // diagonal
    spr_.fillTriangle(x, y, x + w - t, y + h, x + w, y + h, colour);
}

void DashUI::drawValue(int x, int y, int w, int h, Icon icon, const char *value,
                       bool degree, uint16_t colour, bool alarm) {
    // Bad state: the box flashes ~2 Hz between a red fill with yellow
    // content and the normal black with red content.
    uint16_t bg = COL_BG;
    if (alarm && (millis() / ALARM_FLASH_MS) % 2 == 0) {
        bg = COL_RED;
        colour = COL_YELLOW;
        spr_.fillRoundRect(x, y, w, h, 6, bg);
    }
    spr_.drawRoundRect(x, y, w, h, 6, COL_EDGE);

    // icon on the left, hard against the edge to leave room for the value
    const int icx = x + 17, icy = y + h / 2;
    if (icon == Icon::Coolant) drawCoolantIcon(icx, icy, colour, bg);
    else                       drawBatteryIcon(icx, icy, colour);

    // Value in ValueDigits, right-aligned, each character in a fixed slot from
    // its advance (digits 18 px, '.' 7 px) so nothing shifts as it changes.
    // Digit ink spans baseline-22 .. baseline, so baseline = centre + 11.
    const int baseY = y + h / 2 + 11;
    int right = x + w - 4;
    if (degree) {                                  // the font has no degree sign
        spr_.drawCircle(right - 3, baseY - 19, 3, colour);
        spr_.drawCircle(right - 3, baseY - 19, 2, colour);
        right -= 9;
    }
    spr_.setFreeFont(&ValueDigits);
    spr_.setTextDatum(L_BASELINE);
    spr_.setTextColor(colour);
    char one[2] = {0, 0};
    for (int i = strlen(value) - 1; i >= 0; i--) {
        const char ch = value[i];
        if (ch < ValueDigits.first || ch > ValueDigits.last) continue;
        right -= ValueDigitsGlyphs[ch - ValueDigits.first].xAdvance;
        one[0] = ch;
        spr_.drawString(one, right, baseY);
    }
    spr_.setTextFont(1);
}

// Coolant telltale: thermometer standing in two waves (about 30 x 32 px).
void DashUI::drawCoolantIcon(int cx, int cy, uint16_t c, uint16_t bg) {
    const int top = cy - 16;
    // stem
    spr_.fillRoundRect(cx - 3, top, 7, 20, 3, c);
    spr_.fillRect(cx - 1, top + 4, 3, 12, bg);            // hollow centre
    spr_.fillRect(cx - 1, top + 10, 3, 6, c);             // "mercury"
    // bulb
    spr_.fillCircle(cx, top + 21, 5, c);
    // scale ticks
    for (int i = 0; i < 3; i++) spr_.drawFastHLine(cx + 6, top + 3 + i * 5, 5, c);
    // waves
    for (int row = 0; row < 2; row++) {
        const int wy = cy + 9 + row * 5;
        int px = cx - 14, py = wy;
        for (int xx = cx - 14; xx <= cx + 14; xx++) {
            const int yy = wy + (int)lroundf(1.8f * sinf((xx - cx) * 0.55f));
            spr_.drawLine(px, py, xx, yy, c);
            spr_.drawLine(px, py + 1, xx, yy + 1, c);
            px = xx; py = yy;
        }
    }
}

// Battery telltale: body with two terminals and + / - signs (about 30 x 22 px).
void DashUI::drawBatteryIcon(int cx, int cy, uint16_t c) {
    const int bw = 30, bh = 18;
    const int bx = cx - bw / 2, by = cy - bh / 2 + 3;
    spr_.fillRect(bx + 4, by - 4, 6, 4, c);                // terminals
    spr_.fillRect(bx + bw - 10, by - 4, 6, 4, c);
    spr_.drawRoundRect(bx, by, bw, bh, 3, c);              // body (2 px wall)
    spr_.drawRoundRect(bx + 1, by + 1, bw - 2, bh - 2, 2, c);
    spr_.fillRect(bx + 5, by + 8, 6, 2, c);                // "-"
    spr_.fillRect(bx + bw - 11, by + 8, 6, 2, c);          // "+"
    spr_.fillRect(bx + bw - 9, by + 6, 2, 6, c);
}

// ---------------------------------------------------------- diagnostics page
//
// Every value the CAN node sends, raw where scaling is still unconfirmed,
// then link and dash health underneath.

void DashUI::diagRow(int x, int y, const char *label, const char *value, uint16_t colour) {
    spr_.setTextDatum(TL_DATUM);
    spr_.setTextColor(COL_LABEL);
    spr_.drawString(label, x, y, 2);
    spr_.setTextColor(colour);
    spr_.drawString(value, x + 62, y, 2);
}

void DashUI::drawDiag(const DashView &v) {
    char s[48];
    const bool live = v.linkAlive;

    // header: title left, data source + link state right
    spr_.setTextDatum(TL_DATUM);
    spr_.setTextColor(COL_ORANGE);
    spr_.drawString("DIAGNOSTICS", 4, 0, 2);
    snprintf(s, sizeof(s), "%s  link %s", v.demo ? "SIM" : "RS-485", live ? "OK" : "LOST");
    spr_.setTextDatum(TR_DATUM);
    spr_.setTextColor(live ? COL_GREEN : COL_RED);
    spr_.drawString(s, W - 4, 0, 2);
    spr_.drawFastHLine(0, 17, W, COL_EDGE);

    const int y0 = 20, dy = 12;   // 9 rows on the left (incl. battery starts)
    const int lx = 4, rx = 168;
    int y = y0;

    // ---- left column: engine / chassis values ----
    snprintf(s, sizeof(s), "%u", v.rpm);
    diagRow(lx, y, "RPM", s, COL_TEXT); y += dy;

    if (v.gear == 0)                       snprintf(s, sizeof(s), "N");
    else if (v.gear == TELEM_GEAR_UNKNOWN) snprintf(s, sizeof(s), "-- (0xFF)");
    else                                   snprintf(s, sizeof(s), "%u", v.gear);
    diagRow(lx, y, "Gear", s, COL_TEXT); y += dy;

    snprintf(s, sizeof(s), "%d%%  (%u)", (int)lroundf(v.throttle * 100.0f / 255.0f), v.throttle);
    diagRow(lx, y, "Throttle", s, COL_TEXT); y += dy;

    if (v.coolantOk) snprintf(s, sizeof(s), "%.1f C", v.coolantC);
    else             snprintf(s, sizeof(s), "--");
    diagRow(lx, y, "Coolant", s, COL_TEXT); y += dy;

    if (v.vbatOk) snprintf(s, sizeof(s), "%.2f V  (%u)", v.vbatRawMv / 1000.0f, v.vbatRawMv);
    else          snprintf(s, sizeof(s), "--");
    diagRow(lx, y, "Battery", s, COL_TEXT); y += dy;

    snprintf(s, sizeof(s), "%.1f km/h  (%u)", v.speedFront, v.wheelFront);
    diagRow(lx, y, "Front", s, COL_TEXT); y += dy;

    snprintf(s, sizeof(s), "%.1f km/h  (%u)", v.speedRear, v.wheelRear);
    diagRow(lx, y, "Rear", s, COL_TEXT);
    y += dy;
    if (v.batt.historyN) {
        snprintf(s, sizeof(s), "%.1f V  rest %.1f V", v.batt.crankMinV, v.batt.restV);
        const uint16_t hc = v.batt.health == BattHealth::Bad ? COL_RED
                          : v.batt.health == BattHealth::Weak ? COL_AMBER : COL_TEXT;
        diagRow(lx, y, "Crank", s, hc); y += dy;
        int o = 0;
        for (int i = 0; i < v.batt.historyN && o < (int)sizeof(s) - 6; i++)
            o += snprintf(s + o, sizeof(s) - o, "%.1f ", v.batt.history[i]);
        diagRow(lx, y, "Starts", s, COL_LABEL);
    } else {
        diagRow(lx, y, "Crank", "no start yet", COL_LABEL);
    }

    // ---- right column: switch / status flags ----
    const uint8_t f = v.flags;
    y = y0;
    diagRow(rx, y, "Clutch",   (f & TELEM_FLAG_CLUTCH_IN) ? "IN" : "out",
            (f & TELEM_FLAG_CLUTCH_IN) ? COL_CYAN : COL_TEXT); y += dy;
    diagRow(rx, y, "Kill sw",  (f & TELEM_FLAG_KILL_RUN) ? "run" : "STOP",
            (f & TELEM_FLAG_KILL_RUN) ? COL_TEXT : COL_RED); y += dy;
    diagRow(rx, y, "Stand",    (f & TELEM_FLAG_STAND_UP) ? "up" : "DOWN",
            (f & TELEM_FLAG_STAND_UP) ? COL_TEXT : COL_AMBER); y += dy;
    diagRow(rx, y, "Map",      (f & TELEM_FLAG_MAP2) ? "2" : "1", COL_TEXT); y += dy;
    diagRow(rx, y, "Thr sw",   (f & TELEM_FLAG_THROTTLE_OPEN) ? "open" : "closed", COL_TEXT); y += dy;
    diagRow(rx, y, "CAN bus",  (f & TELEM_FLAG_CAN_OK) ? "OK" : "NO DATA",
            (f & TELEM_FLAG_CAN_OK) ? COL_GREEN : COL_RED); y += dy;
    snprintf(s, sizeof(s), "0x%02X", f);
    diagRow(rx, y, "Flags", s, COL_TEXT);

    // ---- link + dash health ----
    spr_.drawFastHLine(0, y0 + 9 * dy + 2, W, COL_EDGE);
    spr_.setTextDatum(TL_DATUM);
    spr_.setTextColor(COL_LABEL);
    char line[64];
    snprintf(line, sizeof(line), "%.1f fr/s  ok %lu  crc %lu  drop %lu  seq %u",
             v.stats.framesPerSec, (unsigned long)v.stats.framesOk,
             (unsigned long)v.stats.crcErrors, (unsigned long)v.stats.seqDrops, v.seq);
    spr_.drawString(line, 4, y0 + 9 * dy + 5, 2);
    snprintf(line, sizeof(line), "up %lu s   heap %u k   psram %u k",
             (unsigned long)(millis() / 1000), (unsigned)(ESP.getFreeHeap() / 1024),
             (unsigned)(ESP.getFreePsram() / 1024));
    spr_.drawString(line, 4, y0 + 9 * dy + 20, 2);
}

// ---------------------------------------------------------------- fuel page
//
//  FUEL                                   learned x1.03 (2 fills)
//  ------------------------------------------------------------
//  [pump] RANGE TO EMPTY         IN TANK
//     234 km                     8.4 L
//                                [#########-------]
//  ------------------------------------------------------------
//  AVG          NOW            SINCE FILL-UP
//  5.2 L/100    4.8 L/100      3.1 L  58 km
//  ------------------------------------------------------------
//            2 taps: fill up
//
// Numbers stay white; the fuel icon and tank gauge carry the warning colour.

void DashUI::drawFuelIcon(int cx, int cy, uint16_t c) {
    // fuel pump: body, window, hose and nozzle (about 20 x 24 px)
    const int x = cx - 10, y = cy - 12;
    spr_.fillRoundRect(x, y, 13, 24, 2, c);              // body
    spr_.fillRect(x + 3, y + 3, 7, 6, TFT_BLACK);        // display window
    spr_.fillRect(x - 2, y + 22, 17, 2, c);              // base
    spr_.drawLine(x + 13, y + 6, x + 18, y + 9, c);      // hose
    spr_.drawLine(x + 18, y + 9, x + 18, y + 18, c);
    spr_.drawLine(x + 19, y + 9, x + 19, y + 18, c);
    spr_.drawLine(x + 18, y + 18, x + 15, y + 20, c);
}

void DashUI::drawFuel(const DashView &v) {
    const FuelView &f = v.fuel;
    if (f.editing) { drawFuelEditor(f); return; }

    char s[32];
    const bool flashOn = (millis() / 400) % 2;

    uint16_t warn = COL_GREEN;
    if (f.rangeKm < FUEL_LOW_AMBER_KM) warn = COL_AMBER;
    if (f.rangeKm < FUEL_LOW_KM)       warn = flashOn ? COL_RED : 0x5000;

    // header
    spr_.setTextDatum(TL_DATUM);
    spr_.setTextColor(COL_ORANGE);
    spr_.drawString("FUEL", 4, 0, 2);
    if (f.learnedFills > 0) snprintf(s, sizeof(s), "learned x%.2f (%u fill%s)", f.kRatio,
                                     f.learnedFills, f.learnedFills == 1 ? "" : "s");
    else                    snprintf(s, sizeof(s), "not calibrated yet");
    spr_.setTextDatum(TR_DATUM);
    spr_.setTextColor(COL_LABEL);
    spr_.drawString(s, W - 4, 0, 2);
    spr_.drawFastHLine(0, 17, W, COL_EDGE);

    // ---- range (left) ----
    drawFuelIcon(14, 32, warn == COL_GREEN ? COL_TEXT : warn);
    spr_.setTextDatum(TL_DATUM);
    spr_.setTextColor(COL_LABEL);
    spr_.drawString("RANGE TO EMPTY", 36, 22, 2);
    snprintf(s, sizeof(s), "%d", (int)lroundf(f.rangeKm));
    spr_.setTextColor(COL_TEXT);
    spr_.setTextDatum(BR_DATUM);
    drawDigitsRight(BigDigits, s, 124, 94, COL_TEXT);  // same Arial Bold as road speed
    spr_.setTextDatum(BL_DATUM);
    spr_.drawString("km", 130, 94, 4);

    // ---- in tank + gauge (right) ----
    const int gx = 176, gw = W - gx - 6;
    spr_.setTextDatum(TL_DATUM);
    spr_.setTextColor(COL_LABEL);
    spr_.drawString("IN TANK", gx, 22, 2);
    snprintf(s, sizeof(s), "%.1f", f.litres);
    spr_.setTextColor(COL_TEXT);
    spr_.setTextDatum(BL_DATUM);
    spr_.drawString(s, gx, 66, 4);
    spr_.drawString("L", gx + spr_.textWidth(s, 4) + 6, 66, 4);
    snprintf(s, sizeof(s), "/ %.0f", f.capacity);
    spr_.setTextDatum(BR_DATUM);
    spr_.setTextColor(COL_LABEL);
    spr_.drawString(s, W - 6, 64, 2);

    const int gy = 70, gh = 18;
    spr_.drawRoundRect(gx, gy, gw, gh, 4, COL_EDGE);
    const float frac = (f.capacity > 0) ? constrain(f.litres / f.capacity, 0.0f, 1.0f) : 0;
    const int fw = (int)((gw - 4) * frac);
    if (fw > 0) spr_.fillRoundRect(gx + 2, gy + 2, fw, gh - 4, 3, warn);
    for (int q = 1; q < 4; q++)                          // quarter ticks
        spr_.drawFastVLine(gx + gw * q / 4, gy + gh, 4, COL_LABEL);

    spr_.drawFastHLine(0, 98, W, COL_EDGE);

    // ---- consumption row ----
    const int ry = 104, cy = 124;
    spr_.setTextDatum(TL_DATUM);
    spr_.setTextColor(COL_LABEL);
    spr_.drawString("AVG", 6, ry, 2);
    spr_.drawString("NOW", 104, ry, 2);
    spr_.drawString("SINCE FILL-UP", 196, ry, 2);

    spr_.setTextColor(COL_TEXT);
    if (f.avgL100 > 0) snprintf(s, sizeof(s), "%.1f", f.avgL100);
    else               snprintf(s, sizeof(s), "--");
    spr_.drawString(s, 6, cy, 4);
    spr_.setTextColor(COL_LABEL);
    spr_.drawString("L/100", 6 + spr_.textWidth(s, 4) + 4, cy + 8, 2);

    spr_.setTextColor(COL_TEXT);
    const bool moving = f.instL100 > 0;
    if (moving)               snprintf(s, sizeof(s), "%.1f", f.instL100);
    else if (f.rateLph > 0.05f) snprintf(s, sizeof(s), "%.2f", f.rateLph);
    else                      snprintf(s, sizeof(s), "--");
    spr_.drawString(s, 104, cy, 4);
    spr_.setTextColor(COL_LABEL);
    spr_.drawString(moving ? "L/100" : "L/h", 104 + spr_.textWidth(s, 4) + 4, cy + 8, 2);

    snprintf(s, sizeof(s), "%.1f L  %.0f km", f.usedSinceFill, f.kmSinceFill);
    spr_.setTextColor(COL_TEXT);
    spr_.drawString(s, 196, cy + 4, 2);

    spr_.drawFastHLine(0, 150, W, COL_EDGE);

    // ---- footer hint ----
    spr_.setTextDatum(MC_DATUM);
    if (f.editBlocked) {
        spr_.setTextColor(COL_RED);
        spr_.drawString("STOP THE BIKE TO FILL UP", W / 2, 161, 2);
    } else {
        spr_.setTextColor(COL_LABEL);
        spr_.drawString("2 taps: fill up      1 tap: next page", W / 2, 161, 2);
    }
}

void DashUI::drawFuelEditor(const FuelView &f) {
    char s[32];
    spr_.setTextDatum(TL_DATUM);
    spr_.setTextColor(COL_ORANGE);
    spr_.drawString("FILL UP", 4, 0, 2);
    spr_.setTextDatum(TR_DATUM);
    spr_.setTextColor(COL_LABEL);
    spr_.drawString(f.editStep == 0 ? "step 1/2: type" : "step 2/2: litres", W - 4, 0, 2);
    spr_.drawFastHLine(0, 17, W, COL_EDGE);

    if (f.editStep == 0) {
        // two option boxes, selected one filled
        const int bw = 146, bh = 70, by = 34;
        const int bx[2] = {8, W - 8 - bw};
        const char *lbl[2] = {"FULL TANK", "PARTIAL"};
        for (int i = 0; i < 2; i++) {
            const bool sel = (i == 0) == f.editFull;
            if (sel) spr_.fillRoundRect(bx[i], by, bw, bh, 8, COL_ORANGE);
            else     spr_.drawRoundRect(bx[i], by, bw, bh, 8, COL_EDGE);
            spr_.setTextDatum(MC_DATUM);
            spr_.setTextColor(sel ? COL_BG : COL_LABEL);
            spr_.drawString(lbl[i], bx[i] + bw / 2, by + bh / 2, 4);
        }
        spr_.setTextDatum(MC_DATUM);
        spr_.setTextColor(COL_LABEL);
        spr_.drawString("1 tap: switch     2 taps: next", W / 2, 128, 2);
        spr_.drawString("3 taps: cancel", W / 2, 150, 2);
        return;
    }

    // step 2: litres
    spr_.setTextDatum(TC_DATUM);
    spr_.setTextColor(COL_LABEL);
    spr_.drawString(f.editFull ? "Litres pumped to fill the tank" : "Litres added",
                    W / 2, 22, 2);

    snprintf(s, sizeof(s), "%.1f", f.editLitres);
    spr_.setTextColor(COL_TEXT);
    spr_.setTextDatum(MR_DATUM);
    spr_.drawString(s, W / 2 + 40, 72, 7);
    spr_.setTextDatum(ML_DATUM);
    spr_.drawString("L", W / 2 + 48, 80, 4);

    spr_.setTextDatum(MC_DATUM);
    if (f.editFull && f.editLitres <= 0) {
        spr_.setTextColor(COL_AMBER);
        spr_.drawString("0 = amount unknown: tank set full, no learning", W / 2, 112, 2);
    } else if (f.editFull) {
        spr_.setTextColor(COL_LABEL);
        spr_.drawString("tank set full, consumption model learns", W / 2, 112, 2);
    } else {
        spr_.setTextColor(COL_LABEL);
        snprintf(s, sizeof(s), "tank will show %.1f L",
                 fminf(f.capacity, f.litres + f.editLitres));
        spr_.drawString(s, W / 2, 112, 2);
    }

    spr_.setTextColor(COL_LABEL);
    spr_.drawString("1 tap: +0.5    4 taps: -0.5", W / 2, 134, 2);
    spr_.drawString("2 taps: save     3 taps: cancel", W / 2, 154, 2);
}

// ---------------------------------------------------------------- clock page
//
// Full-width HH:MM in ClockDigits (Arial Black, 82 px digits, 72 px tabular
// slots, 315 px in all), centred. Normally nothing else is drawn; the header
// and footer only appear in the set-time editor.

void DashUI::drawClock(const DashView &v) {
    const ClockView &c = v.clock;

    const int dw = ClockDigits.glyph['0' - ClockDigits.first].xAdvance;   // 72
    const int colonW = ClockDigits.glyph[':' - ClockDigits.first].xAdvance;
    const int totalW = 4 * dw + colonW;          // 315 px
    const int x0 = (W - totalW) / 2;
    const int pair2 = x0 + 2 * dw + colonW;
    // digit ink spans baseline-80 .. baseline+1; free band is y 18..149
    const int baseY = (18 + 149) / 2 + 40;

    char hs[4], ms[4];
    if (c.valid) {
        snprintf(hs, sizeof(hs), "%02u", c.hour);
        snprintf(ms, sizeof(ms), "%02u", c.minute);
    } else {
        snprintf(hs, sizeof(hs), "--");
        snprintf(ms, sizeof(ms), "--");
    }

    const uint16_t digitCol = c.valid ? COL_TEXT : COL_DIM;
    drawDigitsRight(ClockDigits, hs, x0 + 2 * dw, baseY, digitCol);
    drawDigitsRight(ClockDigits, ms, pair2 + 2 * dw, baseY, digitCol);

    // colon: steady until the time is known, then blinks each second
    if (!c.valid || c.second % 2 == 0) drawDigitsRight(ClockDigits, ":", pair2, baseY, digitCol);

    if (!c.valid) {
        spr_.setTextDatum(MC_DATUM);
        spr_.setTextColor(COL_LABEL);
        spr_.drawString("Waiting for GPS", W / 2, 161, 2);
    }
}

// ---------------------------------------------------------------- trip page
//
//  TODAY  since 00:00        |  SINCE REFUEL
//         123.4 km           |        456.7 km
//           4.2 L            |         18.3 L
//  L/100        5.1          |  L/100        4.9
//  Riding      2:15          |  Riding      8:40
//  Avg/Max   72/118          |  Avg/Max   68/131

static void fmtHM(char *s, size_t n, uint32_t secs) {
    snprintf(s, n, "%lu:%02lu", (unsigned long)(secs / 3600), (unsigned long)(secs / 60 % 60));
}

void DashUI::drawTripSet(const TripSetView &t, int x, const char *title, const char *subtitle) {
    char s[24];

    spr_.setTextDatum(TL_DATUM);
    spr_.setTextColor(COL_ORANGE);
    spr_.drawString(title, x + 4, 0, 2);
    if (subtitle) {
        spr_.setTextColor(COL_LABEL);
        spr_.drawString(subtitle, x + 4 + spr_.textWidth(title, 2) + 6, 0, 2);
    }

    // distance: big digits while they fit
    const int numRight = x + 118;
    if (t.km < 1000) {
        snprintf(s, sizeof(s), t.km < 100 ? "%.1f" : "%.0f", t.km);
        drawDigitsRight(BigDigits, s, numRight, 60, COL_TEXT);
    } else {
        snprintf(s, sizeof(s), "%.0f", t.km);
        spr_.setTextDatum(BR_DATUM);
        spr_.setTextColor(COL_TEXT);
        spr_.drawString(s, numRight, 60, 4);
    }
    spr_.setTextDatum(BL_DATUM);
    spr_.setTextColor(COL_LABEL);
    spr_.drawString("km", numRight + 6, 60, 2);

    // fuel used
    snprintf(s, sizeof(s), "%.1f", t.fuelL);
    spr_.setTextDatum(BR_DATUM);
    spr_.setTextColor(COL_TEXT);
    spr_.drawString(s, numRight, 92, 4);
    spr_.setTextDatum(BL_DATUM);
    spr_.setTextColor(COL_LABEL);
    spr_.drawString("L", numRight + 6, 92, 2);

    // smaller figures
    const int rowX = x + 6, valX = x + 152;
    const auto row = [&](int y, const char *label, const char *value) {
        spr_.setTextDatum(TL_DATUM);
        spr_.setTextColor(COL_LABEL);
        spr_.drawString(label, rowX, y, 2);
        spr_.setTextDatum(TR_DATUM);
        spr_.setTextColor(COL_TEXT);
        spr_.drawString(value, valX, y, 2);
    };

    if (t.avgL100 > 0) snprintf(s, sizeof(s), "%.1f", t.avgL100);
    else               snprintf(s, sizeof(s), "--");
    row(102, "L/100", s);

    fmtHM(s, sizeof(s), t.movingS);
    row(122, "Riding", s);

    if (t.avgKmh > 0) snprintf(s, sizeof(s), "%.0f / %.0f", t.avgKmh, t.maxKmh);
    else              snprintf(s, sizeof(s), "-- / %.0f", t.maxKmh);
    row(142, "Avg / max", s);
}

void DashUI::drawTrip(const DashView &v) {
    drawTripSet(v.trip.today, 0, "TODAY", "since 00:00");
    drawTripSet(v.trip.sinceRefuel, W / 2, "SINCE REFUEL", nullptr);
    spr_.drawFastHLine(0, 17, W, COL_EDGE);
    spr_.drawFastVLine(W / 2 - 1, 0, H, COL_EDGE);
}

// ---------------------------------------------------------------- tyres page

static void fmtPressure(char *s, size_t n, float bar) {
#if TPMS_PSI
    snprintf(s, n, "%.0f", bar * 14.5038f);
#else
    snprintf(s, n, "%.2f", bar);
#endif
}

void DashUI::drawTyreTile(int x, int y, int w, int h, const char *label,
                          const TyreReading &r, bool lowWarn) {
    const bool flashOn = (millis() / 400) % 2;
    const bool stale = r.valid && r.ageS > TPMS_STALE_S;
    uint16_t edge = COL_EDGE;
    if (lowWarn) edge = flashOn ? COL_RED : 0x5000;
    spr_.drawRoundRect(x, y, w, h, 8, edge);
    if (lowWarn) spr_.drawRoundRect(x + 1, y + 1, w - 2, h - 2, 7, edge);

    spr_.setTextDatum(TL_DATUM);
    spr_.setTextColor(COL_LABEL);
    spr_.drawString(label, x + 8, y + 6, 2);
    if (r.paired) {
        spr_.setTextDatum(TR_DATUM);
        spr_.drawString(r.tag, x + w - 8, y + 6, 2);
    }

    char s[24];
    if (!r.paired || !r.valid) {
        spr_.setTextDatum(MC_DATUM);
        spr_.setTextColor(COL_LABEL);
        spr_.drawString(r.paired ? "waiting..." : "not paired", x + w / 2, y + h / 2, 4);
        return;
    }

    fmtPressure(s, sizeof(s), r.bar);
    spr_.setTextDatum(BR_DATUM);
    spr_.setTextColor(stale ? COL_LABEL : COL_TEXT);
    spr_.drawString(s, x + w - 46, y + 78, 7);
    spr_.setTextDatum(BL_DATUM);
    spr_.drawString(TPMS_PSI ? "psi" : "bar", x + w - 42, y + 76, 2);

    spr_.setTextDatum(TL_DATUM);
    spr_.setTextColor(COL_LABEL);
    if (r.ageS < 60) snprintf(s, sizeof(s), "%d C  %lus ago", r.tempC, (unsigned long)r.ageS);
    else             snprintf(s, sizeof(s), "%d C  %lum ago", r.tempC, (unsigned long)(r.ageS / 60));
    spr_.drawString(s, x + 8, y + h - 36, 2);
    if (r.battV > 0) snprintf(s, sizeof(s), "sensor %.1f V", r.battV);
    else             snprintf(s, sizeof(s), "signal %d dBm", r.rssi);
    spr_.setTextColor((r.battV > 0 && r.battV < TPMS_SENSOR_BATT_LOW_V) ? COL_AMBER : COL_LABEL);
    spr_.drawString(s, x + 8, y + h - 20, 2);
}

void DashUI::drawTyres(const DashView &v) {
    const TyreView &t = v.tyres;
    if (t.pairing) { drawTyrePairing(t); return; }

    spr_.setTextDatum(TL_DATUM);
    spr_.setTextColor(COL_ORANGE);
    spr_.drawString("TYRES", 4, 0, 2);
    spr_.setTextDatum(TR_DATUM);
    spr_.setTextColor(COL_LABEL);
    char s[40];
    char lo1[8], lo2[8];
    fmtPressure(lo1, sizeof(lo1), TPMS_FRONT_LOW_BAR);
    fmtPressure(lo2, sizeof(lo2), TPMS_REAR_LOW_BAR);
    snprintf(s, sizeof(s), "low below %s / %s %s", lo1, lo2, TPMS_PSI ? "psi" : "bar");
    spr_.drawString(s, W - 4, 0, 2);
    spr_.drawFastHLine(0, 17, W, COL_EDGE);

    const int tw = (W - 12) / 2, th = 126, ty = 22;
    const bool fLow = t.front.valid && t.front.ageS <= TPMS_STALE_S && t.front.bar < TPMS_FRONT_LOW_BAR;
    const bool rLow = t.rear.valid && t.rear.ageS <= TPMS_STALE_S && t.rear.bar < TPMS_REAR_LOW_BAR;
    drawTyreTile(4, ty, tw, th, "FRONT", t.front, fLow);
    drawTyreTile(8 + tw, ty, tw, th, "REAR", t.rear, rLow);

    spr_.setTextDatum(MC_DATUM);
    spr_.setTextColor(COL_LABEL);
    spr_.drawString("2 taps: pair sensors      1 tap: next page", W / 2, 161, 2);
}

void DashUI::drawTyrePairing(const TyreView &t) {
    spr_.setTextDatum(TL_DATUM);
    spr_.setTextColor(COL_ORANGE);
    spr_.drawString(t.pairStep == 0 ? "PAIR FRONT SENSOR" : "PAIR REAR SENSOR", 4, 0, 2);
    spr_.setTextDatum(TR_DATUM);
    spr_.setTextColor(COL_LABEL);
    spr_.drawString("strongest signal first", W - 4, 0, 2);
    spr_.drawFastHLine(0, 17, W, COL_EDGE);

    if (t.seenCount == 0) {
        spr_.setTextDatum(MC_DATUM);
        spr_.setTextColor(COL_TEXT);
        spr_.drawString("No sensors heard yet", W / 2, 60, 4);
        spr_.setTextColor(COL_LABEL);
        spr_.drawString("Spin the wheel or let a little air out:", W / 2, 92, 2);
        spr_.drawString("caps send more often when something changes.", W / 2, 110, 2);
    } else {
        char s[64];
        for (int i = 0; i < t.seenCount; i++) {
            const int ry = 24 + i * 28;
            const bool sel = i == t.pairSel;
            if (sel) spr_.fillRoundRect(2, ry, W - 4, 24, 4, COL_ORANGE);
            char p[8];
            fmtPressure(p, sizeof(p), t.seen[i].bar);
            snprintf(s, sizeof(s), "%s  %-6s  %s %s   %d dBm   %lus",
                     t.seen[i].tag, t.seen[i].type, p, TPMS_PSI ? "psi" : "bar",
                     t.seen[i].rssi, (unsigned long)t.seen[i].ageS);
            spr_.setTextDatum(ML_DATUM);
            spr_.setTextColor(sel ? COL_BG : COL_TEXT);
            spr_.drawString(s, 10, ry + 12, 2);
        }
    }
    spr_.setTextDatum(MC_DATUM);
    spr_.setTextColor(COL_LABEL);
    spr_.drawString("Taps - 1: next  2: assign  3: exit  4: skip", W / 2, 161, 2);
}

// ---------------------------------------------------------------- GPS page
//
//  +----------------------------------------+
//  | 87 km/h                        ( N )   |
//  | 3 wpt  9 sat                  (compass)|
//  |            trail ~~~ [^] you           |
//  |                                        |
//  | 500 m          -33.899 151.234         |
//  +----------------------------------------+
//
// The trail fills the screen, north-up and centred on the bike, so it stays still when
// stopped, when GPS course means nothing. Everything else is drawn on top of it.
// The compass is driven by GPS course, so it only works while moving.

static const int GPS_CX = W / 2;
static const int GPS_CY = H / 2;

// Rotates (x, y) clockwise by angle, about (cx, cy). y points down on screen.
static inline void rotatePoint(float x, float y, float sinA, float cosA, int cx, int cy, int &ox, int &oy) {
    ox = cx + (int)lroundf(x * cosA - y * sinA);
    oy = cy + (int)lroundf(x * sinA + y * cosA);
}

void DashUI::drawGps(const DashView &v) {
    const NavModel &n = *v.nav;
    if (n.menuIsOpen()) {
        drawGpsMenu(n);
        return;
    }

    drawGpsMap(n);
    drawGpsCompass(n, W - 36, 36, 33);
    drawGpsInfo(n);

    const char *toast = n.toast();
    if (toast) {
        spr_.fillRoundRect(GPS_CX - 70, GPS_CY - 16, 140, 32, 6, COL_ORANGE);
        spr_.setTextDatum(MC_DATUM);
        spr_.setTextColor(COL_BG);
        spr_.drawString(toast, GPS_CX, GPS_CY, 2);
    }
}

void DashUI::drawGpsMap(const NavModel &n) {
    if (!n.hasPosition()) {
        spr_.setTextDatum(MC_DATUM);
        spr_.setTextColor(COL_TEXT);
        spr_.drawString("WAITING FOR GPS FIX", GPS_CX, 70, 2);
        spr_.setTextColor(COL_LABEL);
        char s[16];
        snprintf(s, sizeof(s), "%u satellites", n.sats());
        spr_.drawString(s, GPS_CX, 92, 2);
        return;
    }

    const NavPoint here = n.position();
    const float pxPerM = 1.0f / n.mapMetersPerPixel();

    const auto project = [&](const NavPoint &p, int &sx, int &sy) {
        float x, y;
        NavModel::offsetMeters(here, p, x, y);
        sx = GPS_CX + (int)lroundf(x * pxPerM);
        sy = GPS_CY - (int)lroundf(y * pxPerM);
    };

    // line to the waypoint being navigated to, dashed
    if (n.navigating()) {
        int tx, ty;
        project(n.targetPos(), tx, ty);
        const int dx = tx - GPS_CX, dy = ty - GPS_CY;
        const int steps = max(abs(dx), abs(dy)) / 4;
        for (int i = 0; i < steps; i += 2) {
            spr_.drawLine(GPS_CX + dx * i / steps, GPS_CY + dy * i / steps,
                          GPS_CX + dx * (i + 1) / steps, GPS_CY + dy * (i + 1) / steps, COL_YELLOW);
        }
    }

    // snail trail, ending at the current position
    int px = 0, py = 0;
    for (int i = 0; i <= n.trailCount() && n.trailCount() > 0; i++) {
        int sx = GPS_CX, sy = GPS_CY;
        if (i < n.trailCount()) project(n.trailPoint(i), sx, sy);
        if (i > 0) spr_.drawLine(px, py, sx, sy, COL_CYAN);
        px = sx;
        py = sy;
    }

    // breadcrumbs
    spr_.setTextDatum(ML_DATUM);
    for (int i = 0; i < n.waypointCount(); i++) {
        const NavWaypoint &w = n.waypoint(i);
        int sx, sy;
        project(w.pos, sx, sy);
        const bool target = n.navigating() && w.id == n.targetId();
        spr_.fillCircle(sx, sy, target ? 4 : 3, target ? COL_YELLOW : COL_ORANGE);
        char s[8];
        snprintf(s, sizeof(s), "%u", w.id);
        spr_.setTextColor(target ? COL_YELLOW : COL_ORANGE);
        spr_.drawString(s, sx + 6, sy, 1);
    }

    // current position: pointer when moving, dot when stopped
    if (n.headingValid()) {
        const float rad = n.headingDeg() * (float)M_PI / 180.0f;
        const float sinA = sinf(rad), cosA = cosf(rad);
        int ax, ay, bx, by, cx, cy;
        rotatePoint(0, -10, sinA, cosA, GPS_CX, GPS_CY, ax, ay);
        rotatePoint(-7, 8, sinA, cosA, GPS_CX, GPS_CY, bx, by);
        rotatePoint(7, 8, sinA, cosA, GPS_CX, GPS_CY, cx, cy);
        spr_.fillTriangle(ax, ay, bx, by, cx, cy, COL_TEXT);
    } else {
        spr_.fillCircle(GPS_CX, GPS_CY, 4, COL_TEXT);
    }

    if (!n.fix()) {
        spr_.fillRoundRect(GPS_CX - 40, 2, 80, 20, 4, COL_BG);
        spr_.setTextDatum(TC_DATUM);
        spr_.setTextColor(COL_RED);
        spr_.drawString("GPS LOST", GPS_CX, 4, 2);
    }
}

void DashUI::drawGpsCompass(const NavModel &n, int cx, int cy, int r) {
    const bool valid = n.headingValid();
    const float heading = valid ? n.headingDeg() : 0;
    const uint16_t ring = valid ? COL_TEXT : COL_LABEL;

    // The ring turns against the heading, so the direction of travel is always at the top.
    const float ringRad = -heading * (float)M_PI / 180.0f;

    spr_.fillCircle(cx, cy, r + 1, COL_BG);
    spr_.drawCircle(cx, cy, r, ring);
    spr_.fillTriangle(cx - 4, cy - r - 3, cx + 4, cy - r - 3, cx, cy - r + 3, COL_ORANGE);

    static const char *const CARDINALS[4] = {"N", "E", "S", "W"};
    spr_.setTextDatum(MC_DATUM);
    for (int i = 0; i < 4; i++) {
        const float a = i * (float)M_PI / 2.0f + ringRad;
        spr_.setTextColor(i == 0 ? COL_RED : ring);
        spr_.drawString(CARDINALS[i], cx + (int)lroundf(sinf(a) * (r - 8)),
                        cy - (int)lroundf(cosf(a) * (r - 8)), 1);
    }

    char s[8];
    if (n.navigating() && n.arrived()) {
        spr_.setTextColor(COL_GREEN);
        spr_.drawString("HERE", cx, cy, 2);
    } else if (n.navigating() && valid) {
        // Points the way relative to the direction of travel.
        const float rad = (n.targetBearingDeg() - heading) * (float)M_PI / 180.0f;
        const float sinA = sinf(rad), cosA = cosf(rad);
        int tipX, tipY, lX, lY, rX, rY, nX, nY;
        rotatePoint(0, -19, sinA, cosA, cx, cy, tipX, tipY);
        rotatePoint(-11, 13, sinA, cosA, cx, cy, lX, lY);
        rotatePoint(11, 13, sinA, cosA, cx, cy, rX, rY);
        rotatePoint(0, 5, sinA, cosA, cx, cy, nX, nY);
        spr_.fillTriangle(tipX, tipY, lX, lY, nX, nY, COL_YELLOW);
        spr_.fillTriangle(tipX, tipY, rX, rY, nX, nY, COL_YELLOW);
    } else if (n.navigating()) {
        // Stopped: there is no direction of travel, so show the compass bearing instead.
        snprintf(s, sizeof(s), "%03.0f", n.targetBearingDeg());
        spr_.setTextColor(COL_YELLOW);
        spr_.drawString(s, cx, cy, 2);
    } else {
        if (valid) snprintf(s, sizeof(s), "%03.0f", heading);
        else       snprintf(s, sizeof(s), "---");
        spr_.setTextColor(ring);
        spr_.drawString(s, cx, cy, 2);
    }
}

void DashUI::drawGpsInfo(const NavModel &n) {
    char s[32];

    // top left: speed, with what's being navigated to or the waypoint count below it
    if (n.fix()) snprintf(s, sizeof(s), "%.0f", n.kmh());
    else         snprintf(s, sizeof(s), "--");
    const int speedW = spr_.textWidth(s, 4);
    spr_.fillRect(0, 0, speedW + 42, 27, COL_BG);
    spr_.setTextDatum(TL_DATUM);
    spr_.setTextColor(COL_TEXT);
    spr_.drawString(s, 3, 1, 4);
    spr_.setTextColor(COL_LABEL);
    spr_.drawString("km/h", speedW + 8, 11, 1);

    if (n.navigating()) {
        const float d = n.targetDistM();
        char dist[16];
        if (d < 1000) snprintf(dist, sizeof(dist), "%.0f m", d);
        else          snprintf(dist, sizeof(dist), "%.2f km", d / 1000.0f);
        if (n.tracBack())                     snprintf(s, sizeof(s), "TracBack %s", dist);
        else if (n.targetId() == n.finalId()) snprintf(s, sizeof(s), "To W%u %s", n.targetId(), dist);
        else                                  snprintf(s, sizeof(s), "W%u>W%u %s", n.targetId(), n.finalId(), dist);
        spr_.fillRect(0, 28, spr_.textWidth(s, 2) + 6, 16, COL_BG);
        spr_.setTextColor(COL_YELLOW);
        spr_.drawString(s, 3, 28, 2);
    } else {
        snprintf(s, sizeof(s), "%d wpt  %u sat", n.waypointCount(), n.sats());
        spr_.fillRect(0, 28, spr_.textWidth(s, 1) + 6, 11, COL_BG);
        spr_.setTextColor(n.fix() ? COL_LABEL : COL_RED);
        spr_.drawString(s, 3, 29, 1);
    }

    // bottom: distance to the top and bottom edges of the map, then position on one line
    const float half = n.mapMetersPerPixel() * GPS_CY;
    if (half < 1000) snprintf(s, sizeof(s), "%.0f m", half);
    else             snprintf(s, sizeof(s), "%.1f km", half / 1000.0f);
    spr_.fillRect(0, H - 13, spr_.textWidth(s, 1) + 6, 13, COL_BG);
    spr_.setTextDatum(BL_DATUM);
    spr_.setTextColor(COL_LABEL);
    spr_.drawString(s, 3, H - 2, 1);

    if (n.hasPosition()) {
        const NavPoint p = n.position();
        snprintf(s, sizeof(s), "%.3f %.3f", p.latE7 * 1e-7, p.lonE7 * 1e-7);
        const int tw = spr_.textWidth(s, 4);
        spr_.fillRect(W - tw - 6, H - 26, tw + 6, 26, COL_BG);
        spr_.setTextDatum(BR_DATUM);
        spr_.setTextColor(n.fix() ? COL_TEXT : COL_LABEL);
        spr_.drawString(s, W - 3, H - 1, 4);
    }
}

// ---------------------------------------------------------------- GPS data page
//
//  GPS DATA                               -33.89900 151.23400
//  SPEED        HEADING       ELEVATION
//  87 km/h      245           152 m
//  TO GO        BEARING       TIME TO GO
//  1.24 km      230           0:51
//  TODAY        MOVING        ACCURACY
//  123 km       2:15          6 m

void DashUI::drawGpsData(const DashView &v) {
    const NavModel &n = *v.nav;
    char s[32];

    spr_.setTextDatum(TL_DATUM);
    spr_.setTextColor(COL_ORANGE);
    spr_.drawString("GPS DATA", 4, 0, 2);
    if (n.hasPosition()) {
        const NavPoint p = n.position();
        snprintf(s, sizeof(s), "%.5f %.5f", p.latE7 * 1e-7, p.lonE7 * 1e-7);
    } else {
        snprintf(s, sizeof(s), "no position yet");
    }
    spr_.setTextDatum(TR_DATUM);
    spr_.setTextColor(n.fix() ? COL_TEXT : COL_LABEL);
    spr_.drawString(s, W - 4, 0, 2);
    spr_.drawFastHLine(0, 17, W, COL_EDGE);

    const auto field = [&](int col, int row, const char *label, const char *value, uint16_t colour) {
        const int x = col * (W / 3) + 5, y = 20 + row * 50;
        spr_.setTextDatum(TL_DATUM);
        spr_.setTextColor(COL_LABEL);
        spr_.drawString(label, x, y, 1);
        spr_.setTextColor(colour);
        spr_.drawString(value, x, y + 12, 4);
    };

    const bool fix = n.fix();
    const bool nav = n.navigating();

    if (fix) snprintf(s, sizeof(s), "%.0f km/h", n.kmh());
    else     snprintf(s, sizeof(s), "--");
    field(0, 0, "SPEED", s, COL_TEXT);

    if (n.headingValid()) snprintf(s, sizeof(s), "%03.0f", n.headingDeg());
    else                  snprintf(s, sizeof(s), "---");
    field(1, 0, "HEADING", s, COL_TEXT);

    if (fix) snprintf(s, sizeof(s), "%d m", n.altitudeM());
    else     snprintf(s, sizeof(s), "--");
    field(2, 0, "ELEVATION", s, COL_TEXT);

    if (nav) {
        const float d = n.targetDistM();
        if (d < 1000) snprintf(s, sizeof(s), "%.0f m", d);
        else          snprintf(s, sizeof(s), "%.1f km", d / 1000.0f);
    } else {
        snprintf(s, sizeof(s), "--");
    }
    field(0, 1, "TO GO", s, COL_YELLOW);

    if (nav) snprintf(s, sizeof(s), "%03.0f", n.targetBearingDeg());
    else     snprintf(s, sizeof(s), "---");
    field(1, 1, "BEARING", s, COL_YELLOW);

    // time to go at the current speed, as h:mm:ss or m:ss
    if (nav && fix && n.kmh() >= NAV_ETE_MIN_KMH) {
        const uint32_t secs = (uint32_t)(n.targetDistM() / (n.kmh() / 3.6f));
        if (secs >= 3600) snprintf(s, sizeof(s), "%lu:%02lu:%02lu", (unsigned long)(secs / 3600),
                                   (unsigned long)(secs / 60 % 60), (unsigned long)(secs % 60));
        else              snprintf(s, sizeof(s), "%lu:%02lu", (unsigned long)(secs / 60), (unsigned long)(secs % 60));
    } else {
        snprintf(s, sizeof(s), "--");
    }
    field(2, 1, "TIME TO GO", s, COL_YELLOW);

    snprintf(s, sizeof(s), v.trip.today.km < 100 ? "%.1f km" : "%.0f km", v.trip.today.km);
    field(0, 2, "TODAY", s, COL_TEXT);

    fmtHM(s, sizeof(s), v.trip.today.movingS);
    field(1, 2, "MOVING", s, COL_TEXT);

    if (fix) snprintf(s, sizeof(s), "%.0f m", n.accuracyM());
    else     snprintf(s, sizeof(s), "--");
    field(2, 2, "ACCURACY", s, COL_TEXT);

    const char *toast = n.toast();
    if (toast) {
        spr_.fillRoundRect(W / 2 - 70, H / 2 - 16, 140, 32, 6, COL_ORANGE);
        spr_.setTextDatum(MC_DATUM);
        spr_.setTextColor(COL_BG);
        spr_.drawString(toast, W / 2, H / 2, 2);
    }
}

void DashUI::drawGpsMenu(const NavModel &n) {
    spr_.setTextDatum(TL_DATUM);
    spr_.setTextColor(COL_ORANGE);
    spr_.drawString("GO TO WAYPOINT", 4, 0, 2);
    spr_.drawFastHLine(0, 17, W, COL_EDGE);

    // five rows, scrolling to keep the selected one in view
    static const int ROWS = 5;
    const int count = n.menuCount();
    const int sel = n.menuIndex();
    const int first = constrain(sel - ROWS / 2, 0, max(0, count - ROWS));

    char s[32];
    for (int row = 0; row < ROWS && first + row < count; row++) {
        const int item = first + row;
        const int y = 22 + row * 26;
        const bool selected = item == sel;
        if (selected) spr_.fillRoundRect(2, y, W - 4, 24, 4, COL_ORANGE);
        n.menuLabel(item, s, sizeof(s));
        spr_.setTextDatum(ML_DATUM);
        spr_.setTextColor(selected ? COL_BG : COL_TEXT);
        spr_.drawString(s, 10, y + 12, 2);
    }

    spr_.setTextDatum(MC_DATUM);
    spr_.setTextColor(COL_LABEL);
    spr_.drawString("Taps - 1: next  4: back  2: choose  3: exit", W / 2, 161, 2);
}

// ---------------------------------------------------------------- alert banner

void DashUI::drawAlert(const DashView &v) {
    const bool flashOn = (millis() / 400) % 2;
    const uint16_t c = v.alertLevel >= 2 ? COL_RED : COL_AMBER;
    const int y = 104, h = 66;
    spr_.fillRect(0, y, W, h, COL_BG);
    spr_.fillRoundRect(2, y + 2, W - 4, h - 4, 8, flashOn ? c : COL_BG);
    spr_.drawRoundRect(2, y + 2, W - 4, h - 4, 8, c);
    spr_.drawRoundRect(3, y + 3, W - 6, h - 6, 7, c);
    spr_.setTextDatum(TC_DATUM);
    spr_.setTextColor(flashOn ? COL_BG : c);
    spr_.drawString(v.alert1, W / 2, y + 10, 4);
    spr_.setTextColor(flashOn ? COL_BG : COL_TEXT);
    spr_.drawString(v.alert2, W / 2, y + 40, 2);
}
